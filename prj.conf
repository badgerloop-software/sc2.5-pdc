## CMakeLists.txt
```
cmake_minimum_required(VERSION 3.28.0)

list(
    APPEND
        EXTRA_CONF_FILE
           ${CMAKE_CURRENT_SOURCE_DIR}/embedded-pio/zephyrcan/zephyrcan.conf
           ${CMAKE_CURRENT_SOURCE_DIR}/embedded-pio/updatemanager_eth/updatemanager_eth.conf
)

find_package(Zephyr REQUIRED HINTS $ENV{ZEPHYR_BASE})
project(PDC LANGUAGES C CXX)

target_include_directories(app 
    PRIVATE 
        include
)


target_sources(app PRIVATE 

    src/main.cpp
    src/speed_calc.cpp
    src/IOManagement.cpp
    src/motor_control.cpp 
    src/canPDC.cpp
    inc/canPDC.h
    inc/speed_calc.h
    inc/IOManagement.h
    inc/const.h
    inc/motor_control.h)


 add_subdirectory(embedded-pio/zephyrcan)
  add_subdirectory(embedded-pio/updatemanager_eth)


 

target_link_libraries(app
      PRIVATE
          zephyrcan
          updatemanager_eth
  )
```

## prj.conf
```kconfig
CONFIG_LOG=y

CONFIG_CPP=y
CONFIG_STD_CPP17=y
CONFIG_GLIBCXX_LIBCPP=y
CONFIG_NEWLIB_LIBC=y
CONFIG_HEAP_MEM_POOL_SIZE=4096
CONFIG_GPIO=y
CONFIG_ADC=y
```

## app.overlay
```dts
/ {
    motor_speed {
        interrupt-gpios = <&gpioa 8 (GPIO_ACTIVE_HIGH | GPIO_PULL_DOWN)>;
    };
    mcu_dir {
        interrupt-gpios = <&gpib 7 (GPIO_ACTIVE_HIGH | GPIO_PULL_DOWN)>;
    };
    
    mcu_eco {
        interrupt-gpios = <&gpib 1 (GPIO_ACTIVE_HIGH | GPIO_PULL_DOWN)>;
    };
    
    mcu_mc_on {
        interrupt-gpios = <&gpia 10 (GPIO_ACTIVE_HIGH | GPIO_PULL_DOWN)>;
    };

    prk_telem {
        interrupt-gpios = <&gpib 4 (GPIO_ACTIVE_HIGH | GPIO_PULL_DOWN)>;
    };

    brk_telem{
        interrupt-gpios = <&gpia 10 (GPIO_ACTIVE_HIGH | GPIO_PULL_DOWN)>;

    }'
};
```

## src/main.cpp
```c
#include <Arduino.h>

#include "IOManagement.h"
#include "adc.h"
#include "canPDC.h"
#include "const.h"
#include "motor_control.h"
#include "speed_calc.h"

// For random
#include <stdlib.h>
#include <time.h>

// DEBUG_TECHNIQUE selects the operating mode:
//   0 = Production / normal operation (state machine + real I/O)
//   1 = Random CAN echo (no state machine, sends random data for CAN testing)
#define DEBUG_TECHNIQUE 0

int counter = 0;

CANPDC canBus(CAN1, DEF);

static const char *pdcStateToString(PDCStates state) {
  switch (state) {
  case PDCStates::OFF:
    return "OFF";
  case PDCStates::PARK:
    return "PARK";
  case PDCStates::IDLE:
    return "IDLE";
  case PDCStates::FORWARD:
    return "FORWARD";
  case PDCStates::REVERSE:
    return "REVERSE";
  case PDCStates::CRUISE:
    return "CRUISE";
  default:
    return "UNKNOWN";
  }
}

#if DEBUG_TECHNIQUE == 1
void randomizeData();
void debugPrint();

void randomizeData() {
  // Use realistic ranges for each signal
  acc_out = ((float)rand() / RAND_MAX);     // 0.0–1.0 (AnalogOut range)
  regen_brake = ((float)rand() / RAND_MAX); // 0.0–1.0
  lv_12V_telem =
      ((float)rand() / RAND_MAX) * 12.0; // 0–12V (after divider scaling)
  lv_5V_telem = ((float)rand() / RAND_MAX) * 5.0;          // 0–5V
  lv_5V_current = ((float)rand() / RAND_MAX) * 3.3;        // 0–3.3V
  current_in_telem = ((float)rand() / RAND_MAX) * 3.3;     // 0–3.3V
  brake_pressed = rand() % 2;
  digital_data.brake_led = brake_pressed;

  // Random digital data
  digital_data.direction = rand() % 2;
  digital_data.mc_speed_sig = rand() % 2;
  digital_data.eco_mode = rand() % 2;
  digital_data.mcu_mc_on = rand() % 2;
  digital_data.park_brake = rand() % 2;
}

void debugPrint() {
#ifdef DEBUG_PRINTS
  Serial.printf("acc_in: %f\n", acc_in);
  Serial.printf("acc_out: %f\n", acc_out);
  Serial.printf("regen_brake: %f\n", regen_brake);
  Serial.printf("lv_12V_telem: %f\n", lv_12V_telem);
  Serial.printf("lv_5V_telem: %f\n", lv_5V_telem);
  Serial.printf("lv_5V_current: %f\n", lv_5V_current);
  Serial.printf("current_in_telem: %f\n", current_in_telem);
  Serial.printf("brake_pressed: %i\n", brake_pressed);
  Serial.printf("brakeLED: %i\n", digital_data.brake_led);
  Serial.printf("digital_data.direction: %i\n", digital_data.direction);
  Serial.printf("digital_data.mc_speed_sig: %i\n", digital_data.mc_speed_sig);
  Serial.printf("digital_data.eco_mode: %i\n", digital_data.eco_mode);
  Serial.printf("digital_data.mcu_mc_on: %i\n", digital_data.mcu_mc_on);
  Serial.printf("digital_data.park_brake: %i\n", digital_data.park_brake);
#endif
}
#endif

// setup
void setup() {
  Serial.begin(115200);
#ifdef DEBUG_PRINTS
  Serial.printf("Starting up...\n");
#endif
  digitalWrite(PB6, HIGH);
  initIO();
  startSpeedCalculation();

#if DEBUG_TECHNIQUE == 0
  // Production mode: start the state machine
  initPDCState();
#elif DEBUG_TECHNIQUE == 1
  // Random echo mode: seed RNG, no state machine
  // Many embedded boards don't have a real-time clock, so time(NULL)
  // can return 0 every boot. Use millis() so the seed varies based on boot
  // time.
  srand(millis());
  randomizeData();
#endif
}

// loop
void loop() {
#if DEBUG_TECHNIQUE == 0
  // Production: state machine runs via its timer interrupt.
  // Just send data and process CAN queue.
#ifdef DEBUG_PRINTS
  {
    static uint32_t lastDebugMs = 0;
    uint32_t nowMs = millis();
    if (nowMs - lastDebugMs >= 1000) {
      lastDebugMs = nowMs;
      Serial.printf(
          "state=%s can_dir=%s fr=%u acc_in_raw=%u "
          "acc_in=%.3f acc_out=%.3f regen=%.3f rpm=%.1f mph=%.1f "
          "brake=%u brake_v=%.3f park=%u mcu_dir=%u eco=%u brake_led=%u\n",
          pdcStateToString(get_state()),
          forwardAndReverse == FORWARD_VALUE ? "Fwd" : "Rev", forwardAndReverse,
          acc_in_raw, acc_in, acc_out, regen_brake, rpm, mph,
          brake_pressed, brake_pressure_telem, digital_data.park_brake,
          digital_data.direction, digital_data.eco_mode, digital_data.brake_led);
    }
  }
#endif
#elif DEBUG_TECHNIQUE == 1
  // Random echo: periodically regenerate random values
  if (counter >= COUNTER_EXP) {
    randomizeData();
    debugPrint();
    counter = 0;
    // Show what we received from the steering wheel / test board
#ifdef DEBUG_PRINTS
    Serial.printf("Received forwardAndReverse: %i\n", forwardAndReverse);
#endif
  }
  counter++;
#endif

  canBus.sendPDCData();
  canBus.runQueue(DATA_SEND_PERIOD);
}
```

## include/IOManagement.h
```c
#ifndef __IO_MANAGER_H__
#define __IO_MANAGER_H__

#include "PID.h"
#include "adc.h"
#include "const.h"

// Outputs
#define MCU_DIR PB7
#define MCU_ECO PB1

// Inputs
#define MCU_MC_ON PA10
#define MCU_SPEED_SIG PA8
#define PRK_BRK_TELEM PB4
#define BRAKE_TELEM PA0

struct Digital_Data {
  bool direction : 1;    // output
  bool mc_speed_sig : 1; // input
  bool eco_mode : 1;     // output
  bool mcu_mc_on : 1;    // input (physical motor controller key switch)
  bool park_brake : 1;   // input (sourced from CAN when test board is used)
  bool brake_led : 1;    // output (pedal brake or regen >= threshold)
};

extern volatile Digital_Data digital_data;

extern volatile uint16_t acc_in_raw;
extern volatile float acc_in;
extern volatile float acc_out;
extern volatile float regen_in;
extern volatile float regen_brake;
extern volatile float lv_12V_telem;
extern volatile float lv_5V_telem;
extern volatile float lv_5V_current;
extern volatile float current_in_telem;
extern volatile bool brake_pressed;
extern volatile float brake_pressure_telem;
extern volatile float mph;
extern volatile float rpm;

// initialize digital and analog pins
void initIO();

// setup rising-edge interrupt on MCU_SPEED_SIG (PA8) to count PWM pulses
void initSpeedCounter();

// read digital and analog inputs
void readIO();

// Set the value of output pins
void set_direction(bool dir);
void set_eco_mode(bool eco);
void writeAccOut(float newAccOut);
void writeRegenBrake(float newRegenBrake);

#endif
```

## include/canPDC.h
```c
#ifndef __CAN_PDC_H__
#define __CAN_PDC_H__

#include "IOManagement.h"
#include "canmanager.h"

// Macros for the CAN message IDs
#define FORWARD_AND_REVERSE_ID 0x300
#define REGEN_BRAKE_INPUT_ID 0x301
#define THROTTLE_INPUT_ID 0x302
#define DRIVE_MODE_INPUT_ID 0x303
// 0x210 payload: byte 0 = active (0/1), bytes 1-4 = target MPH (float).
#define CRUISE_STATUS_OUTPUT_ID 0x210

class CANPDC : public CANManager {
public:
  CANPDC(CAN_TypeDef *canPort, CAN_PINS pins, int frequency = DEFAULT_CAN_FREQ);
  void readHandler(CAN_message_t msg);
  // Sends the cruise active state and target MPH when either changes.
  void sendPDCData();
};

extern volatile bool forwardAndReverse;
extern volatile bool cruise_toggle_button_pressed;
extern volatile bool cruise_inc;
extern volatile bool cruise_dec;

// 0x300 requires two bytes: existing controls, then regen button in bit 0
extern volatile bool regen_button_pressed;
extern volatile bool cruise_cancel_pending;
extern volatile bool cruise_toggle_pending;
static constexpr uint32_t STEERING_CONTROL_TIMEOUT_MS = 250U;
bool steeringControlsFresh(uint32_t current_time_ms);
void resetCruiseMainButton();
// Call only from the state timer or with interrupts masked
void resetCruiseButtonEvents();

#endif
```

## include/const.h
```c
#ifndef __CONST_H__
#define __CONST_H__

/**
 * Debugging Techniques:
 * 1. Send random data over CAN and verify if you received the same random data
 */

// Uncomment when building for the can-bounce test board.
// When defined, park_brake is sourced from CAN instead of GPIO.
// #define TEST_MODE

// Uncomment to enable Serial debug prints. Comment out for production
// to save CPU cycles and reduce latency.
#define DEBUG_PRINTS

#define COUNTER_EXP 2

#define IO_UPDATE_PERIOD 50000 // us
#define PID_UPDATE_INTERVAL                                                    \
  (IO_UPDATE_PERIOD /                                                          \
   1000000.0f) // sec, float division to avoid truncation to 0

#define INA180_CURRENT_MULTIPLIER                                              \
  10 // multiplies analog current telem to convert it into a readable value

// How fast to transmit data over CAN in ms (and debug prints if on)
#define DATA_SEND_PERIOD 50

///////////////
// PID macros
///////////////
// Todo: tune these
#define POWER_P_PARAM 0.0
#define POWER_I_PARAM 0.0
#define POWER_D_PARAM 0.0
#define SPEED_P_PARAM 2.5
#define SPEED_I_PARAM 0.0
#define SPEED_D_PARAM 0.0

// limits for power and speed PIDs.
#define MIN_POWER 0.0
#define MAX_POWER 1.0
#define MIN_RPM 0.0
#define MAX_RPM 1000.0

// limits for outputs of PID
// is 0.0 to 1.0 due to how AnalogOut pins work.
#define MIN_OUT 0.0
#define MAX_OUT 1.0

//////////////////////
// State machine stuff
/////////////////////
enum class PDCStates : uint8_t {
  OFF,
  PARK,
  IDLE,
  FORWARD,
  REVERSE,
  CRUISE,
};

extern volatile PDCStates pdcState;

#define FORWARD_VALUE 0
#define REVERSE_VALUE 1

///////////////
// Speed stuff
///////////////

#define MIN_MOVING_SPEED 3.0 // speed threshold for idle state

#define REGEN_BRAKE_LIGHT_THRESHOLD 0.05f // 5% regen turns brake lights on

// Stable IO samples (IO_UPDATE_PERIOD = 50 ms) before brake state changes.
#define BRAKE_DEBOUNCE_PRESS_SAMPLES 3   // ~150 ms to assert
#define BRAKE_DEBOUNCE_RELEASE_SAMPLES 2 // ~100 ms to release

#define BRAKE_ADC_CHANNEL ADC_CHANNEL_5 // PA0 (ADC1_IN5 on STM32L432)
#define BRAKE_PRESSURE_THRESHOLD_V 1.65f

#endif
```

## include/motor_control.h
```c
#ifndef __MOTOR_CONTROL_H__
#define __MOTOR_CONTROL_H__

#include "Arduino.h"
#include "const.h"
#include "IOManagement.h"
#include "STM32TimerInterrupt_Generic.h"
#include "canPDC.h"

static constexpr float MIN_CRUISE_SPEED_MPH = 3.0f;
static constexpr float CRUISE_DISENGAGE_INPUT_THRESHOLD = 0.01f;

void initPDCState();
void transition();
PDCStates get_state();

extern volatile float cruise_target_mph;
// Incremented by the state-machine interrupt when cruise state or target changes.
extern volatile uint32_t cruise_status_update_version;
extern volatile bool cruise_inc_pending;
extern volatile bool cruise_dec_pending;

#endif
```

## include/speed_calc.h
```c
#ifndef __SPEED_CALC_H__
#define __SPEED_CALC_H__

#include "const.h"
#include "IOManagement.h"

#define SPEED_CALC_INTERVAL_US 50000 // us
#define ARRAY_SIZE 20 
#define PULSES_PER_REV 48
#define WHEEL_CIRCUMFERENCE 69 // inches

#define MCU_SPEED_SIG PA8

void startSpeedCalculation();


// Starts speed (RPM and MPH) calculations at specified interval
extern volatile float mph;
extern volatile uint8_t previousPulses[ARRAY_SIZE];

#endif  
```

## src/IOManagement.cpp
```c
#include "IOManagement.h"
#include <zephyr/kernel.h>
#include <zephyr/devicetree/gpio.h>
#include <zephyr/logging/log.h> 

#define MOTOR_SPEED_NODE DT_PATH(motor_speed)
#define MCU_DIR_NODE     DT_PATH(mcu_dir)
#define MCU_ECO_NODE     DT_PATH(mcu_eco)
#define MCU_MC_ON_NODE   DT_PATH(mcu_mc_on)
#define PRK_TELEM_NODE   DT_PATH(prk_telem)
#define BRK_TELEM_NODE   DT_PATH(brk_telem)

volatile Digital_Data digital_data;
LOG_MODULE_REGISTER(my_app_module, LOG_LEVEL_DBG);
 // Callback for speed signal interrupt
static struct gpio_callback mcu_speed_sig_cb; 

static const struct gpio_dt_spec motor_speed =
    GPIO_DT_SPEC_GET(MOTOR_SPEED_NODE, interrupt_gpios);

static const struct gpio_dt_spec mcu_dir =
    GPIO_DT_SPEC_GET(MCU_DIR_NODE, interrupt_gpios);

static const struct gpio_dt_spec mcu_eco =
    GPIO_DT_SPEC_GET(MCU_ECO_NODE, interrupt_gpios);

static const struct gpio_dt_spec mcu_mc_on =
    GPIO_DT_SPEC_GET(MCU_MC_ON_NODE, interrupt_gpios);

static const struct gpio_dt_spec prk_telem =
    GPIO_DT_SPEC_GET(PRK_TELEM_NODE, interrupt_gpios);

static const struct gpio_dt_spec brk_telem =
    GPIO_DT_SPEC_GET(BRK_TELEM_NODE, interrupt_gpios);
K_TIMER_DEFINE(IOTimer, calculateSpeed, NULL);


volatile uint16_t acc_in_raw = 0;
volatile float acc_in = 0;
volatile float acc_out = 0;
volatile float regen_in = 0;
volatile float regen_brake = 0;
volatile float lv_12V_telem = 0;
volatile float lv_5V_telem = 0;
volatile float lv_5V_current = 0;
volatile float current_in_telem = 0;
volatile bool brake_pressed = false;
volatile float brake_pressure_telem = 0.0f;
volatile float mph = 0;
volatile float rpm = 0;

#ifdef DEBUG_PRINTS
static void agentDebugLogBrakeDigital(uint32_t dig, uint32_t mode, uint32_t pupd,
                                      uint32_t idr) {
  // #region agent log


  LOG_DBG(
      "{\"sessionId\":\"03e5a9\",\"runId\":\"digital-pd\",\"hypothesisId\":\"H\","
      "\"location\":\"IOManagement.cpp:readIO\",\"message\":\"brake_digital\","
      "\"data\":{\"brakeDigital\":%lu,\"pa0GpioMode\":%lu,\"pa0Pupd\":%lu,"
      "\"pa0Idr\":%lu,\"brakePressed\":%u,\"brakeTelem\":%.3f},"
      "\"timestamp\":%lu}\n",
      dig, mode, pupd, idr, (unsigned)brake_pressed, brake_pressure_telem,
      k_uptime_get());

  // Serial.printf(
  //     "{\"sessionId\":\"03e5a9\",\"runId\":\"digital-pd\",\"hypothesisId\":\"H\","
  //     "\"location\":\"IOManagement.cpp:readIO\",\"message\":\"brake_digital\","
  //     "\"data\":{\"brakeDigital\":%lu,\"pa0GpioMode\":%lu,\"pa0Pupd\":%lu,"
  //     "\"pa0Idr\":%lu,\"brakePressed\":%u,\"brakeTelem\":%.3f},"
  //     "\"timestamp\":%lu}\n",
  //   dig, mode, pupd, idr, (unsigned)brake_pressed, brake_pressure_telem,
  //    millis());
  // #endregion
}
#endif

// Ticker to poll input readings at fixed rate
//STM32TimerInterrupt IOTimer(TIM7);




// RPM pulse counting
// MC_SPEED_SIG fires 48 pulses per revolution.
// readIO() runs every IO_UPDATE_PERIOD µs and computes RPM from the count.
static volatile uint32_t pulseCount = 0;
#define PULSES_PER_REV 48

// Sample-and-delay debounce state for BRAKE_TELEM (updated in readIO).
static bool brake_last_raw = false;
static uint8_t brake_stable_count = 0;

static void speedPulseISR() { pulseCount++; }

void initSpeedCounter() {
  // attachInterrupt(digitalPinToInterrupt(MCU_SPEED_SIG), speedPulseISR, RISING);
  gpio_pin_configure_dt(&mcu_speed, GPIO_INPUT);
  gpio_init_callback(&mcu_speed_sig_cb, speedPulseISR, BIT(mcu_speed.pin));
  gpio_add_callback(&mcu_speed, BIT(mcu_speed.pin));
  gpio_pin_interrupt_configure_dt(&mcu_speed, GPIO_INT_EDGE_RISING);

} 

DAC_HandleTypeDef hdac;

void initDAC() {
    __HAL_RCC_DAC1_CLK_ENABLE();
    
    hdac.Instance = DAC1;
    HAL_DAC_Init(&hdac);

    DAC_ChannelConfTypeDef config = {0};
    config.DAC_Trigger = DAC_TRIGGER_NONE;
    config.DAC_OutputBuffer = DAC_OUTPUTBUFFER_ENABLE;
    HAL_DAC_ConfigChannel(&hdac, &config, DAC_CHANNEL_1);  // PA4 - regen
    HAL_DAC_ConfigChannel(&hdac, &config, DAC_CHANNEL_2);  // PA5 - accel
    
    HAL_DAC_Start(&hdac, DAC_CHANNEL_1);
    HAL_DAC_Start(&hdac, DAC_CHANNEL_2);

    // PA5 is the default SPI SCK and may be claimed by the Arduino core.
    // Explicitly set it to analog mode so the DAC output isn't overridden.
    GPIO_InitTypeDef GPIO_InitStruct = {0};
    __HAL_RCC_GPIOA_CLK_ENABLE();
    GPIO_InitStruct.Pin  = GPIO_PIN_5;
    GPIO_InitStruct.Mode = GPIO_MODE_ANALOG;
    GPIO_InitStruct.Pull = GPIO_NOPULL;
    HAL_GPIO_Init(GPIOA, &GPIO_InitStruct);
}

void initIO() {

  gpio_pin_configure_dt(&mcu_dir, GPIO_OUTPUT);
  gpio_pin_set_dt(&mcu_dir, FORWARD_VALUE);

  gpio_pin_configure_dt(&mcu_eco, GPIO_OUTPUT);
  gpio_pin_configure_dt(&mcu_mc_on, GPIO_INPUT);
  gpio_pin_configure_dt(&motor_speed, GPIO_INPUT);
  gpio_pin_configure_dt(&prk_telem, GPIO_INPUT);
  gpio_pin_configure_dt(&brk_telem, GPIO_INPUT | GPIO_PULL_DOWN);

  initDAC();
  initADC(ADC1);
  initSpeedCounter();


  k_timer_start(&IOTimer, K_USEC(IO_UPDATE_PERIOD), K_USEC(IO_UPDATE_PERIOD));

  if (k_timer_remaining_get(&IOTimer) > 0) {
#ifdef DEBUG_PRINTS
    printf("starting IO timer\n");
#endif
  } else {
#ifdef DEBUG_PRINTS
    printf("problem starting IO timer\n");
#endif
  }
}

void readIO() {
  // Compute RPM from pulse count since last call.
  // IO_UPDATE_PERIOD is in µs, convert to minutes for RPM.
  uint32_t count = pulseCount;
  pulseCount = 0;
  float interval_min = IO_UPDATE_PERIOD / 60000000.0f; // µs to minutes
  // rpm = (float)count / PULSES_PER_REV / interval_min;

  digital_data.mc_speed_sig = digitalRead(MCU_SPEED_SIG);

#ifndef TEST_MODE
  digital_data.park_brake = false; // digitalRead(PRK_BRK_TELEM);
#endif

  // acc_in is sourced from CAN in readHandler (0x302 production, 0x209 test).
  lv_12V_telem = readADC(ADC_CHANNEL_6) * 3.3 * 35.1 / 5.1;              // PA_1
  lv_5V_telem = readADC(ADC_CHANNEL_12) * 3.3 * 15.1 / 5.1;              // PA_7
  lv_5V_current = readADC(ADC_CHANNEL_15) * INA180_CURRENT_MULTIPLIER;   // PB_0
  current_in_telem = readADC(ADC_CHANNEL_8) * INA180_CURRENT_MULTIPLIER; // PA_3
#ifndef TEST_MODE
  // Digital brake switch: HIGH = pressed. Internal pulldown holds idle at 0.
  // Sample-and-delay: require N stable samples before updating brake_pressed.
  {
    bool raw = digitalRead(BRAKE_TELEM) == HIGH;
    if (raw != brake_last_raw) {
      brake_stable_count = 0;
      brake_last_raw = raw;
    } else if (raw != brake_pressed) {
      uint8_t need = raw ? BRAKE_DEBOUNCE_PRESS_SAMPLES
                         : BRAKE_DEBOUNCE_RELEASE_SAMPLES;
      if (++brake_stable_count >= need) {
        brake_pressed = raw;
        brake_stable_count = 0;
      }
    }
  }
  brake_pressure_telem = brake_pressed ? 3.3f : 0.0f;
  digital_data.brake_led =
      brake_pressed || (regen_in >= REGEN_BRAKE_LIGHT_THRESHOLD);

#ifdef DEBUG_PRINTS
  {
    static uint32_t lastAgentLogMs = 0;
    uint32_t nowMs = millis();
    if (nowMs - lastAgentLogMs >= 1000) {
      lastAgentLogMs = nowMs;
      uint32_t dig = (uint32_t)digitalRead(BRAKE_TELEM);
      uint32_t mode = (GPIOA->MODER >> 0) & 0x3U;
      uint32_t pupd = (GPIOA->PUPDR >> 0) & 0x3U; // 2 = pulldown
      uint32_t idr = (GPIOA->IDR >> 0) & 0x1U;
      agentDebugLogBrakeDigital(dig, mode, pupd, idr);
    }
  }
#endif
#endif
}

void set_direction(bool dir) {
  digitalWrite(MCU_DIR, dir);
  digital_data.direction = dir;
}

void set_eco_mode(bool eco) {
  digitalWrite(MCU_ECO, eco);
  digital_data.eco_mode = eco;
}

void writeAccOut(float newAccOut) {
  // Clamp to valid DAC command range before converting to integer counts.
  if (newAccOut < 0.0f) newAccOut = 0.0f;
  else if (newAccOut > 1.0f) newAccOut = 1.0f;

  acc_out = newAccOut;
  // printf("acc_out: %f\n", acc_out);
  HAL_DAC_SetValue(&hdac, DAC_CHANNEL_2, DAC_ALIGN_12B_R, (uint32_t)(acc_out * 4095.0f));
}

void writeRegenBrake(float newRegenBrake) {
  // Clamp to valid DAC command range before converting to integer counts.
  if (newRegenBrake < 0.0f) newRegenBrake = 0.0f;
  else if (newRegenBrake > 1.0f) newRegenBrake = 1.0f;

  regen_brake = newRegenBrake;
  HAL_DAC_SetValue(&hdac, DAC_CHANNEL_1, DAC_ALIGN_12B_R, (uint32_t)(regen_brake * 4095.0f));
}
```

## src/canPDC.cpp
```c
#include "canPDC.h"
#include "const.h"
#include "motor_control.h"
#include <math.h>

volatile bool forwardAndReverse = false;
volatile bool cruise_toggle_button_pressed = false;
volatile bool cruise_inc = false;
volatile bool cruise_dec = false;

volatile bool regen_button_pressed = false;
volatile bool cruise_cancel_pending = false;
volatile bool cruise_toggle_pending = false;
static bool cruise_toggle_button_armed = false;
static volatile bool steering_controls_received = false;
static volatile uint32_t last_steering_control_ms = 0;

bool steeringControlsFresh(uint32_t current_time_ms) {
  return steering_controls_received &&
      uint32_t(current_time_ms - last_steering_control_ms) < STEERING_CONTROL_TIMEOUT_MS;
}

void resetCruiseMainButton() {
  cruise_toggle_button_armed = false;
  cruise_toggle_pending = false;
}
static bool increase_button_armed = false;
static bool decrease_button_armed = false;

void resetCruiseButtonEvents() {
  cruise_inc_pending = false;
  cruise_dec_pending = false;
  increase_button_armed = false;
  decrease_button_armed = false;
}

// Preserve the interrupt mask so reception and timer consumption cannot interleave
class SteeringReceiveGuard {
 public:
  SteeringReceiveGuard() : previous_interrupt_mask(__get_PRIMASK()) { __disable_irq(); }
  ~SteeringReceiveGuard() { __set_PRIMASK(previous_interrupt_mask); }
 private:
  uint32_t previous_interrupt_mask;
};

static uint8_t lastDriveMode = 0xFF;

static constexpr uint16_t THROTTLE_SENT_MAX = 4095U;

CANPDC::CANPDC(CAN_TypeDef *canPort, CAN_PINS pins, int frequency)
    : CANManager(canPort, pins, frequency) {};

void CANPDC::readHandler(CAN_message_t msg) {
  SteeringReceiveGuard receive_guard;
  switch (msg.id) {
  case FORWARD_AND_REVERSE_ID: { // 0x300
    if (msg.len < 2) break;
    const uint32_t current_time_ms = millis();
    if (!steeringControlsFresh(current_time_ms)) {
      resetCruiseMainButton();
      resetCruiseButtonEvents();
      if (pdcState == PDCStates::CRUISE) cruise_cancel_pending = true;
    }
    last_steering_control_ms = current_time_ms;
    steering_controls_received = true;
    // Byte 0 bit layout per CAN spec:
    //   bit 0: headlight, bit 1: left_blink, bit 2: right_blink,
    //   bit 3: direction_switch, bit 4: horn, bit 5: cruise main button pressed,
    //   bit 6: cruise increase, bit 7: cruise decrease
    // Bit 3 direction_switch: 0 = forward, 1 = reverse on both boards
    bool reverse_selected = ((msg.buf[0] >> 3) & 1) != 0;
    forwardAndReverse = reverse_selected ? REVERSE_VALUE : FORWARD_VALUE;
    cruise_toggle_button_pressed = ((msg.buf[0] >> 5) & 1) != 0;
    cruise_inc = ((msg.buf[0] >> 6) & 1) != 0;
    cruise_dec = ((msg.buf[0] >> 7) & 1) != 0;
    regen_button_pressed = (msg.buf[1] & 1U) != 0;
    // Capture one press, never queue an engagement until driving conditions improve
    const bool driving_forward =
        pdcState == PDCStates::FORWARD && forwardAndReverse == FORWARD_VALUE;
    const bool brakes_released =
        !brake_pressed && !digital_data.park_brake;
    const bool regen_allows_cruise =
        !regen_button_pressed && regen_in <= CRUISE_DISENGAGE_INPUT_THRESHOLD;
    const bool speed_allows_cruise =
        mph >= MIN_CRUISE_SPEED_MPH && rpm >= MIN_MOVING_SPEED;

    const bool can_engage_cruise =
        driving_forward && brakes_released && regen_allows_cruise && speed_allows_cruise;
    if (cruise_toggle_button_pressed && cruise_toggle_button_armed &&
        (pdcState == PDCStates::CRUISE || can_engage_cruise)) {
      cruise_toggle_pending = true;
    }
    cruise_toggle_button_armed = !cruise_toggle_button_pressed;
    if (pdcState == PDCStates::CRUISE && regen_button_pressed) {
      cruise_cancel_pending = true;
    }
    if (cruise_inc && cruise_dec) {
      resetCruiseButtonEvents();
      break;
    }
    const bool cruise_is_active = pdcState == PDCStates::CRUISE;
    const bool cruise_can_continue = !cruise_cancel_pending && !regen_button_pressed;

    const bool accept_adjustment = cruise_is_active && cruise_can_continue;
    if (cruise_inc && increase_button_armed && accept_adjustment) cruise_inc_pending = true;
    if (cruise_dec && decrease_button_armed && accept_adjustment) cruise_dec_pending = true;
    increase_button_armed = !cruise_inc;
    decrease_button_armed = !cruise_dec;
    if (!accept_adjustment) {
      cruise_inc_pending = false;
      cruise_dec_pending = false;
    }
    break;
  }

  case REGEN_BRAKE_INPUT_ID: { // 0x301 regen brake from steering wheel (normalized 0.0–1.0)
    if (msg.len >= sizeof(float)) {
      float regen_val = 0.0f;
      memcpy((void *)&regen_val, msg.buf, sizeof(float));
      if (!isfinite(regen_val)) break;
      if (regen_val < 0.0f)
        regen_val = 0.0f;
      else if (regen_val > 1.0f)
        regen_val = 1.0f;
      regen_in = regen_val;
      if (pdcState == PDCStates::CRUISE && regen_val > CRUISE_DISENGAGE_INPUT_THRESHOLD) {
        cruise_cancel_pending = true;
      }
    }
    break;
  }

#ifndef TEST_MODE
  case THROTTLE_INPUT_ID: { // 0x302 uint16 throttle command in production.
    if (msg.len < sizeof(uint16_t)) break;
    uint16_t throttle_raw = 0;
    memcpy((void *)&throttle_raw, msg.buf, sizeof(uint16_t));
    acc_in_raw = throttle_raw;

    // Steering wheel sends calibrated counts in [0, THROTTLE_SENT_MAX].
    float normalized = (float)throttle_raw / (float)THROTTLE_SENT_MAX;
    if (normalized < 0.0f) {
      normalized = 0.0f;
    } else if (normalized > 1.0f) {
      normalized = 1.0f;
    }
    acc_in = normalized;
    break;
  }

  case DRIVE_MODE_INPUT_ID: { // 0x303 eco/pwr from steering wheel (0=Eco, 1=Pwr)
    if (msg.len >= 1 && msg.buf[0] != lastDriveMode) {
      lastDriveMode = msg.buf[0];
      set_eco_mode(lastDriveMode == 0);
    }
    break;
  }
#endif

#ifdef TEST_MODE
  case 0x209: { // acc_in — sent by test board simulating the pedal.
              // Only used in TEST_MODE; in production 0x302 is used.
    if (msg.len < sizeof(float)) break;
    float test_throttle;
    memcpy(&test_throttle, msg.buf, sizeof(float));
    if (!isfinite(test_throttle)) break;
    acc_in = test_throttle;
    break;
  }
#endif

  default:
    break;
  }
}

void CANPDC::sendPDCData() {
  static uint32_t last_cruise_status_update_version = 0;

  this->sendMessage(0x200, (void *)&acc_out, sizeof(float));
  this->sendMessage(0x201, (void *)&regen_brake, sizeof(float));
  this->sendMessage(0x202, (void *)&lv_12V_telem, sizeof(float));
  this->sendMessage(0x203, (void *)&lv_5V_telem, sizeof(float));
  this->sendMessage(0x204, (void *)&lv_5V_current, sizeof(float));
  this->sendMessage(0x205, (void *)&current_in_telem, sizeof(float));
  this->sendMessage(0x206, (void *)&brake_pressure_telem, sizeof(float));
  this->sendMessage(0x207, (void *)&digital_data, sizeof(digital_data));
  this->sendMessage(0x208, (void *)&mph, sizeof(float));

  // The state-machine timer records cruise state and target changes; transmit
  // from the main loop so CAN I/O is never performed from the timer interrupt.
  if (cruise_status_update_version != last_cruise_status_update_version) {
    uint32_t cruise_status_version;
    uint8_t cruise_status[1 + sizeof(float)];

    // Snapshot all values together; the timer may update them asynchronously.
    noInterrupts();
    cruise_status_version = cruise_status_update_version;
    cruise_status[0] = pdcState == PDCStates::CRUISE ? 1U : 0U;
    const float cruise_target = cruise_target_mph;
    memcpy(&cruise_status[1], &cruise_target, sizeof(cruise_target));
    interrupts();

    if (this->sendMessage(CRUISE_STATUS_OUTPUT_ID, cruise_status,
                          sizeof(cruise_status))) {
      last_cruise_status_update_version = cruise_status_version;
    }
  }
  // 0x209/0x302 are INPUTs received from the pedal/test board — do not
  // re-broadcast.
}
```

## src/motor_control.cpp
```c
#include "motor_control.h"
#include "IOManagement.h"
#include "speed_calc.h"
#include "canPDC.h"

volatile PDCStates pdcState = PDCStates::OFF;
volatile float cruise_target_mph = 0.0f;
volatile uint32_t cruise_status_update_version = 0;
volatile bool cruise_inc_pending = false;
volatile bool cruise_dec_pending = false;

static constexpr float MAX_CRUISE_MPH = 45.0f;
static PID cruise_pid(SPEED_P_PARAM, SPEED_I_PARAM, SPEED_D_PARAM,
            PID_UPDATE_INTERVAL);

STM32TimerInterrupt state_updater(TIM2);

static float clampCruiseTarget(float target_mph) {
  if (target_mph < MIN_CRUISE_SPEED_MPH) {
    return MIN_CRUISE_SPEED_MPH;
  }
  if (target_mph > MAX_CRUISE_MPH) {
    return MAX_CRUISE_MPH;
  }
  return target_mph;
}


void initPDCState() {
  pdcState = PDCStates::PARK;
  cruise_pid.setInputLimits(0.0f, MAX_CRUISE_MPH);
  cruise_pid.setOutputLimits(MIN_OUT, MAX_OUT);
  cruise_pid.setMode(MANUAL_MODE);
  state_updater.attachInterruptInterval(IO_UPDATE_PERIOD, transition);
  set_eco_mode(true);
  set_direction(FORWARD_VALUE);
}

PDCStates get_state() { return pdcState; }

void transition() {
  const PDCStates state_before_transition = pdcState;
  const float cruise_target_before_transition = cruise_target_mph;
  const bool steering_controls_fresh = steeringControlsFresh(millis());
  const bool cruise_toggle_requested = cruise_toggle_pending;
  cruise_toggle_pending = false;
  const bool steering_controls_timed_out = !steering_controls_fresh;
  const bool brake_cancel_requested = brake_pressed || digital_data.park_brake;
  const bool regen_cancel_requested =
      regen_button_pressed || regen_in > CRUISE_DISENGAGE_INPUT_THRESHOLD;
  const bool cancel_cruise = cruise_cancel_pending || steering_controls_timed_out ||
      brake_cancel_requested || regen_cancel_requested;
  cruise_cancel_pending = false;
  if (!steering_controls_fresh) {
    resetCruiseMainButton();
    resetCruiseButtonEvents();
  }

  if (!steering_controls_fresh) {
    if (pdcState == PDCStates::CRUISE) {
      cruise_pid.setMode(MANUAL_MODE);
      pdcState = (rpm < MIN_MOVING_SPEED) ? PDCStates::IDLE : PDCStates::FORWARD;
    }
    writeAccOut(0.0f);
    writeRegenBrake(0.0f);
  } else {
    switch (pdcState) {
    case PDCStates::PARK:
      if (!digital_data.park_brake) {
        pdcState = PDCStates::IDLE;
      }
      writeAccOut(0.0);
      writeRegenBrake(0.0);
      break;

    case PDCStates::IDLE:
      if (digital_data.park_brake) {
        pdcState = PDCStates::PARK;
        break;
      }

      set_direction(forwardAndReverse);
      writeAccOut(acc_in);
      writeRegenBrake(regen_in);

      if (rpm >= MIN_MOVING_SPEED) {
        if (forwardAndReverse == FORWARD_VALUE) {
          pdcState = PDCStates::FORWARD;
        } else {
          pdcState = PDCStates::REVERSE;
        }
      }
      break;

    case PDCStates::REVERSE:
      if (rpm < MIN_MOVING_SPEED) {
        pdcState = PDCStates::IDLE;
      }
      set_direction(REVERSE_VALUE);
      writeAccOut(acc_in);
      writeRegenBrake(regen_in);
      break;

    case PDCStates::FORWARD:
      if (rpm < MIN_MOVING_SPEED) {
        pdcState = PDCStates::IDLE;
        break;
      }

      set_direction(FORWARD_VALUE);
      writeAccOut(acc_in);
      writeRegenBrake(regen_in);

      if (cruise_toggle_requested && !cancel_cruise && !brake_pressed &&
          !regen_button_pressed && forwardAndReverse == FORWARD_VALUE && mph >= MIN_CRUISE_SPEED_MPH &&
          regen_in <= CRUISE_DISENGAGE_INPUT_THRESHOLD) {
        cruise_target_mph = clampCruiseTarget(mph);
        cruise_pid.setSetPoint(cruise_target_mph);
        cruise_pid.setMode(AUTO_MODE);
        pdcState = PDCStates::CRUISE;
      }
      break;

    case PDCStates::CRUISE:
      if (mph < MIN_CRUISE_SPEED_MPH) {
        cruise_pid.setMode(MANUAL_MODE);
        pdcState = (rpm < MIN_MOVING_SPEED) ? PDCStates::IDLE : PDCStates::FORWARD;
        writeAccOut(0.0);
        writeRegenBrake(0.0);
        break;
      }
      if (cruise_toggle_requested || cancel_cruise || brake_pressed || regen_button_pressed ||
        regen_in > CRUISE_DISENGAGE_INPUT_THRESHOLD ||
        forwardAndReverse != FORWARD_VALUE) {
        cruise_pid.setMode(MANUAL_MODE);
        cruise_inc_pending = false;
        cruise_dec_pending = false;
        pdcState = PDCStates::FORWARD;
        writeAccOut(acc_in);
        writeRegenBrake(regen_in);
        break;
      }

      set_direction(FORWARD_VALUE);

      if (cruise_inc_pending) {
        cruise_target_mph += 1.0f;
        cruise_inc_pending = false;
      }
      if (cruise_dec_pending) {
        cruise_target_mph -= 1.0f;
        cruise_dec_pending = false;
      }

      cruise_target_mph = clampCruiseTarget(cruise_target_mph);
      cruise_pid.setSetPoint(cruise_target_mph);
      cruise_pid.setProcessValue(mph);
      writeAccOut(cruise_pid.compute());
      writeRegenBrake(regen_in);
      break;

    default:
      pdcState = PDCStates::PARK;
      break;
    }

  }

  const bool cruise_active_state_changed =
      (state_before_transition == PDCStates::CRUISE) !=
      (pdcState == PDCStates::CRUISE);
  if (cruise_active_state_changed ||
      cruise_target_mph != cruise_target_before_transition) {
    ++cruise_status_update_version;
  }

  if (pdcState != PDCStates::CRUISE) {
    cruise_inc_pending = false;
    cruise_dec_pending = false;
  }

  if (!steering_controls_fresh || brake_pressed || digital_data.park_brake) {
  writeAccOut(0.0);
  writeRegenBrake(0.0);
  }
}
```

## src/speed_calc.cpp
```c
#include "speed_calc.h"
#include "IOManagement.h"
#include <zephyr/kernel.h>
#include <zephyr/devicetree/gpio.h>

#define MCU_DIR_PIN DT_PATH(mcu_dir)
K_TIMER_DEFINE(IOTimer, calculateSpeed, NULL);

#define MOTOR_PIN_INTERUPT DT_PATH(zephyr_user)
static const struct gpio_dt_spec motor_speed_pin = GPIO_DT_SPEC_GET(MOTOR_PIN_INTERUPT, 
                                                                    interrupt_gpios);


volatile uint8_t speedPulses = 0;
static volatile uint8_t previousPulses[ARRAY_SIZE];

static struct gpio_callback mcu_speed_sig_cb; 


K_TIMER_DEFINE(speedCalcTimer, calculateSpeed, NULL);

void increment() {
    speedPulses++;
}

void calculateSpeed(){
    // RPM is always derived from physical MC_SPEED_SIG pulses so the state
    // machine tracks the real motor speed, even when TEST_MODE is active.

    // Variable to track array update position
    static uint8_t calculationCounter = 0;
    static uint16_t runningSum = 0; 

    // Replaces oldest pulse in pulse counter array with a new one
    calculationCounter = (calculationCounter + 1) % ARRAY_SIZE;
    runningSum = runningSum - previousPulses[calculationCounter] + speedPulses;
    previousPulses[calculationCounter] = speedPulses;
    speedPulses = 0;
}

// do not use in ISR context, as it uses floating point 
void calculateMph(uint16_t runningSum, float &rpm, float &mph) {
   float revolutions = runningSum / (float)PULSES_PER_REV;
    rpm = revolutions / (ARRAY_SIZE * SPEED_CALC_INTERVAL_US / 1000000.0 / 60.0 );
    mph = rpm * WHEEL_CIRCUMFERENCE * 0.00094696;

}

void startSpeedCalculation() {
    gpio_pin_configure_dt(&intr_pin, GPIO_INPUT);
    gpio_init_callback(&mcu_speed_sig_cb, intr_handler, BIT(intr_pin.pin));
    gpio_add_callback(&mcu_speed_sig_cb, increment, BIT(intr_pin.pin));
    gpio_pin_interrupt_configure_dt(&intr_pin, GPIO_INT_EDGE_RISING);
   k_timer_start(&speedCalcTimer, K_USEC(SPEED_CALC_INTERVAL_US), K_USEC(SPEED_CALC_INTERVAL_US));
}
```
